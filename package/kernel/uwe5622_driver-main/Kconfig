## package/kernel/uwe5622_driver-main/Kconfig
```kconfig
config SPARD_WLAN_SUPPORT
	bool "Unisoc wireless Support"
	select RK_WIFI_DEVICE_UWE5622  if SPARD_WLAN_SUPPORT
	default n
	help
	  This is support for spreadtrum wireless chip.

if SPARD_WLAN_SUPPORT
source "drivers/net/wireless/uwe5622/unisocwcn/Kconfig"
source "drivers/net/wireless/uwe5622/unisocwifi/Kconfig"
source "drivers/net/wireless/uwe5622/tty-sdio/Kconfig"
endif
```

## package/kernel/uwe5622_driver-main/tty-sdio/Kconfig
```kconfig
config TTY_OVERY_SDIO
	tristate "Spard TTY Overy SDIO Driver"
	help
	  Spard tty overy sdio driver.
```

## package/kernel/uwe5622_driver-main/unisocwcn/Kconfig
```kconfig
#
# UNISOC WCN device (NEW )configuration
#
menu "UNISOC WCN Device Drivers(for new chip...)"

config SC23XX
	bool "SC23XX chip Support"
	default n
	help
	  This is support wcn chip for spreadtrum.
	  if you want to use 23xx series wcn chip of spreadtrum.
	  please say "y".
	  Thanks.

config UMW2653
	tristate "UMW2653 chip Support"
	depends on SC23XX
	default n
	help
	  This is support wcn chip for spreadtrum.
	  If you want to use UMW2653 chip of spreadtrum.
	  Please say "y".
	  Thanks.

config SC2342_INTEG
	tristate "SC2342 Integrated chip Support"
	depends on SC23XX
	default n
	help
	  This is support wcn chip for spreadtrum.
	  If you want to use sc2342 integrated chip of spreadtrum.
	  Please say "y".
	  Thanks.


config SC2355
	tristate "SC2355 chip Support"
	depends on SC23XX
	default n
	help
	  This is support wcn chip for spreadtrum.
	  If you want to use sc2355 chip of spreadtrum.
	  Please say "y".
	  Thanks.

config SC2366
	tristate "SC2366 chip Support"
	depends on SC23XX
	default n
	help
	  This is support wcn chip for spreadtrum.
	  If you want to use sc2366 chip of spreadtrum.
	  Please say "y".
	  Thanks.

config WCN_BSP_DRIVER_BUILDIN
	bool "buildin bsp driver for unisoc chip"
	default n
	help
	  This is support wcn chip for incard board.
	  if you want to buildin bsp driver.
	  please say "y".
	  Thanks.

config RK_WIFI_DEVICE_UWE5621
	bool "rockchip board Support for uwe5621"
	default n
	help
	  This is support wcn chip for rockchip board.
	  if you want to support rockchip board.
	  please say "y".
	  Thanks.

config RK_WIFI_DEVICE_UWE5622
	bool "rockchip board Support for uwe5622"
	default n
	help
	  This is support wcn chip for rockchip board.
	  if you want to support rockchip board.
	  please say "y".
	  Thanks.

config AW_WIFI_DEVICE_UWE5622
	bool "allwinner board Support for uwe5622"
	default n
	help
	  This is support wcn chip for allwinner board.
	  if you want to support allwinner board.
	  please say "y".
	  Thanks.

config AW_BIND_VERIFY
	bool "allwinner wcn bind verify"
	depends on AW_WIFI_DEVICE_UWE5622
	default n
	help
	  This is support wcn bind verify for allwinner board.
	  if you want to do wcn chip bind verify.
	  please say "y".
	  Thanks.

# sprd's boot driver based on SC2342-integ...,etc
#source "drivers/misc/sprdwcn/boot/Kconfig"

# sprd's gnss driver based on SC2355/2342...,etc
#source "drivers/misc/sprdwcn/gnss/Kconfig"

# sprd's SDIO device driver based on SC2355...,etc
#source "drivers/misc/sprdwcn/sdio/Kconfig"

# sprd's SIPC device driver based on SC2342 integ...,etc
#source "drivers/misc/sprdwcn/sipc/Kconfig"

# sprd's sleep device driver based on SC2355...,etc
#source "drivers/misc/sprdwcn/sleep/Kconfig"

# sprd's PCIe device driver based on SC2355...,etc
#source "drivers/misc/sprdwcn/pcie/Kconfig"

# sprd's wcn platform driver based on SC2355/SC2342...,etc
#source "drivers/misc/sprdwcn/platform/Kconfig"

# sprd's USB device driver based on SC2355...,etc
#source "drivers/misc/sprdwcn/usb/Kconfig"

endmenu
```

## package/kernel/uwe5622_driver-main/unisocwcn/gnss/Kconfig
```kconfig
config MARLIN3_GNSSBAK
	tristate "gnss support"
	default n
	help
	  Debug system for Spreadtrum MARLIN3 GNSS chip
	  If unsure, say n.
```

## package/kernel/uwe5622_driver-main/unisocwcn/pcie/Kconfig
```kconfig
config WCN_PCIE
	tristate "PCIE Support"
	depends on SC23XX
        default n
	help
          Enable this module for Spreadtrum SC2355 chip pcie interface bus Support.
          Please insmod this module before any other WCN subsystems.
```

## package/kernel/uwe5622_driver-main/unisocwcn/platform/Kconfig
```kconfig
config WCN_BOOT
	tristate "Core Support"
	help
	Choose Y here if you have this FM radio chip.

	In order to control your ext wcn chip, you will need enable it.
	that include "boot, log, procfs, debugfs, at cmd, loopcheck, dumpmem,
	reset, reboot,etc"

config WCN_UTILS
	bool "wcn debug for read and write register"
	help
	Choose Y here if you need to read/write register of wcn chip,
	this is used for RD debug.

	In order to control or debug your marlin chip, you will need to support
	procfs command to read/write register of marlin chip on.

config WCN_GNSS
	bool "wcn GNSS support"
	default n
	help
	Choose Y here if you need to support gnss.
	this is used for GNSS.

	In order to enable to download gnss fw, you will need to
	support WCN_GNSS.

config MEM_PD
	bool "wcn mem power down support"
	depends on SDIOHAL
	default y
	help
	Choose Y here if you need to support mem_pd.
	this is used for memory power down

	In order to enable sdio memory power save function, you will need to
	support memory power down.


config WCN_PLATFORM
	tristate "Platform Support"
	depends on SC2342_INTEG
	default y
	help
	Enable this module for Spreadtrum WCN integration
	chip debug and manage function.

	In order to control or debug your marlin chip, you will need to
	support procfs command and memory dump,cp log and so on.

config WCN_SWD
	bool "wcn swd support"
	help
	Choose Y here if you need to support SWD.
```

## package/kernel/uwe5622_driver-main/unisocwcn/unisocwcn/sdio/Kconfig
```kconfig
config SDIOHAL
	tristate "SDIO Support"
	depends on SC23XX
	default n
	help
	  Enable this module for Spreadtrum SC2355
	  chip sdio interface bus Support.
	  Please insmod this module before any other
	  WCN subsystems. Thanks.
```

## package/kernel/uwe5622_driver-main/unisocwcn/unisocwcn/sipc/Kconfig
```kconfig
config WCN_SIPC
	tristate "WCN SIPC Support"
	depends on SC2342_INTEG
	default y
	help
	  Enable this module for Spreadtrum WCN integration
	  chip sipc Support.
	  Please insmod this module before any other
	  WCN subsystems. Thanks.
```

## package/kernel/uwe5622_driver-main/unisocwcn/usb/Kconfig
```kconfig
config WCN_USB
	tristate "USB Support"
	depends on UMW2653
	default n
	help
	  Enable this module for MARLIN3E
	  chip usb interface bus Support.
	  Please insmod this module before any other
	  WCN subsystems. Thanks.
```

## package/kernel/uwe5622_driver-main/unisocwifi/Kconfig
```kconfig
config WLAN_UWE5621
	tristate "UWE5621 Wi-Fi Driver"
	help
	  Sprd UWE5621 Wi-Fi Driver.

config WLAN_UWE5622
	tristate "UWE5622 Wi-Fi Driver"
	help
	  Spard UWE5622 Wi-Fi Driver.

config SPRDWL_NG
	tristate "SPRD Next Generation Wireless LAN Support"
	depends on CFG80211
	help
	  This is a driver for the Spreadtrum IEEE802.11 WLAN devices.

	  When compiled as a module, this driver will be called sprdwl_ng.

config UNISOC_WIFI_PS
	bool "Unisoc Wi-Fi Power Save Support"
	depends on WLAN_UWE5622
        help
          Sprd UWE5622 Wi-Fi Driver Power Save.
```

## package/network/utils/iptables/Config.in
```kconfig
#if PACKAGE_iptables

config IPTABLES_IPV4
	bool
	default y
	prompt "iptables binary and essential extensions"

config IPTABLES_IPV6
	bool
	default y if IPV6
	prompt "ip6tables binary and essential extensions"

config IPTABLES_ARPTABLES
	bool

config IPTABLES_EBTABLES
	bool

#endif
```

## package/utils/busybox/Config.in
```kconfig
if PACKAGE_busybox

config BUSYBOX_CUSTOM
	bool "Customize busybox options"
	default n
        help
          Enabling this allows full customization of busybox settings.
          Note that there are many options here that can result in a build
          that doesn't work properly.  Enabling customization will mark your
          build as "tainted" for the purpose of bug reports.
          See the variables written to /etc/openwrt_release

          Unless you know what you are doing, you should leave this as 'n'

	source "Config-defaults.in"

	if BUSYBOX_CUSTOM
	source "config/Config.in"
	endif

config BUSYBOX_USE_FULL_VERSIONS
	bool "(EXPERIMENTAL) Use full versions of commands instead of busybox replacements"
	default n

if BUSYBOX_USE_FULL_VERSIONS
	config BUSYBOX_USE_BRIDGE
		bool "Use full bridge instead of busybox replacement"
		depends on HAS_BRIDGE
		select PACKAGE_bridge
		default y
		help
		  Use the full versions of brctl command from bridge
		  package instead of the cut down busybox replacement for
		  this commands.

	config BUSYBOX_USE_BZIP2
		bool "Use full bzip2 instead of busybox replacements"
		depends on HAS_BZIP2
		select PACKAGE_bzip2
		default y
		help
		  Use the full versions of brctl command from bridge
		  package instead of the cut down busybox replacement for
		  this commands.

	config USE_CIFS_UTILS
		bool "Use full cifs-utils instead of busybox replacement"
		depends on HAS_CIFS_UTILS
		select PACKAGE_cifsmount
		default y
		help
		  Use the full versions of mount.cifs from cifs-utils
		  package instead of the cut down busybox support
		  in busybox's mount.

	config BUSYBOX_USE_COREUTILS
		bool "Use full coreutils instead of busybox replacements"
		depends on HAS_COREUTILS
		select PACKAGE_coreutils
		select PACKAGE_coreutils-busybox
		default y
		help
		  Use the full versions of commands available in coreutils
		  package instead of the cut down busybox replacements for
		  those commands.

	config BUSYBOX_USE_DIFFUTILS
		bool "Use full diffutils cmp instead of busybox replacement"
		depends on HAS_DIFFUTILS
		select PACKAGE_diffutils-cmp
		default y
		help
		  Use the full version of cmp command from diffutils
		  package instead of the cut down busybox replacement for
		  this command.

	config BUSYBOX_USE_FINDUTILS
		bool "Use full findutils instead of busybox replacements"
		depends on HAS_FINDUTILS
		select PACKAGE_findutils-busybox
		default y
		help
		  Use the full version of commands from findutils
		  package instead of the cut down busybox replacements for
		  these commands.

	config BUSYBOX_USE_GREP
		bool "Use full grep instead of busybox replacement"
		depends on HAS_GREP
		select PACKAGE_grep
		default y
		help
		  Use the full version of grep command from grep
		  package instead of the cut down busybox replacement for
		  this command.

	config BUSYBOX_USE_IPROUTE2
		bool "Use full iproute2 instead of busybox replacements"
		depends on HAS_IPROUTE2
		select PACKAGE_iproute2-busybox
		default y
		help
		  Use the full version of ip command from iproute2
		  package instead of the cut down busybox replacement for
		  this command.

	config BUSYBOX_USE_IPUTILS
		bool "Use full iputils instead of busybox replacements"
		depends on HAS_IPUTILS
		select PACKAGE_iputils-busybox
		default y
		help
		  Use the full version of commands from findutils
		  package instead of the cut down busybox replacements for
		  these commands.

	config BUSYBOX_USE_LESS
		bool "Use full less instead of busybox replacement"
		depends on HAS_LESS
		select PACKAGE_less
		default y
		help
		  Use the full version of less command from less
		  package instead of the cut down busybox replacement for
		  this command.

	config BUSYBOX_USE_TAR
		bool "Use full tar instead of busybox replacement"
		depends on HAS_TAR
		select PACKAGE_tar
		default y
		help
		  Use the full version of tar command from netcat
		  package instead of the cut down busybox replacement for

	config BUSYBOX_USE_PROCPS_NG
		bool "Use full procps-ng instead of busybox replacements"
		depends on HAS_PROCPS_NG
		select PACKAGE_procps-ng
		select PACKAGE_procps-ng-busybox
		default y
		help
		  Use the full versions of commands available in util-linux
		  package instead of the cut down busybox replacements for
		  those commands.

	config BUSYBOX_USE_SHADOW_UTILS
		bool "Use full passwd instead of busybox replacement"
		depends on HAS_SHADOW
		select PACKAGE_shadow
		select PACKAGE_shadow-passwd
		default y
		help
		  Use the full version of passwd  command from shadow-utils
		  package instead of the cut down busybox replacement for
		  this command.

	config BUSYBOX_USE_NETCAT
		bool "Use full netcat instead of busybox replacement"
		depends on HAS_NETCAT
		select PACKAGE_netcat
		default y
		help
		  Use the full version of nc command from netcat
		  package instead of the cut down busybox replacement for

	config BUSYBOX_USE_UTIL_LINUX
		bool "Use full util-linux instead of busybox replacements"
		depends on HAS_UTIL_LINUX
		select PACKAGE_util-linux-busybox
		default y
		help
		  Use the full versions of commands available in util-linux
		  package instead of the cut down busybox replacements for
		  those commands.

	config BUSYBOX_USE_VIM
		bool "Use full vim instead of busybox replacement"
		depends on HAS_VIM
		select PACKAGE_vim
		default y
		help
		  Use the full version of vi command from
		  package instead of the cut down busybox replacement for
endif

config BUSYBOX_USE_LIBRPC
	bool
	default y if BUSYBOX_CUSTOM && BUSYBOX_CONFIG_FEATURE_HAVE_RPC
	default y if !BUSYBOX_CUSTOM && BUSYBOX_DEFAULT_FEATURE_HAVE_RPC

endif
```

## target/imagebuilder/files/Config.in
```kconfig
source "Config-build.in"
source "Config-images.in"
source "tmp/.config-targets.in"
```

## target/linux/tegra/image/Config.in
```kconfig
config TEGRA_SD_BOOT_PARTSIZE
	int "Boot filesystem partition size (in MB)"
	depends on TARGET_tegra
	default 16
```

## target/sdk/Config.in
```kconfig
config SDK
	bool "Build the LEDE SDK"
	depends on !EXTERNAL_TOOLCHAIN
	help
	  This is essentially a stripped-down version of the buildroot
	  with a precompiled toolchain. It can be used to develop and
	  test packages for LEDE before including them in the buildroot

config SDK_MINIMAL
	bool "Build a minimal LEDE SDK"
	depends on SDK
	default n
	help
	  Builds the minimum set of packages necessary to create an
          SDK and ImageBuilder combo capable of building images for
	  the desired boards.
```

## target/sdk/files/Config.in
```kconfig
config MODULES
	bool
	default y
	option modules

source "Config-build.in"
source "tmp/.config-package.in"

menu "Configure feeds"
source "tmp/.config-feeds.in"
endmenu
```
