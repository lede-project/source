/dts-v1/;

#include "VOCORE2.dtsi"

/ {
	compatible = "vocore,VoCore2", "mediatek,mt7628an-soc";
	model = "VoCore2";

	memory@0 {
		device_type = "memory";
		reg = <0x0 0x8000000>;
	};
};

&firmware {
	reg = <0x50000 0xfb0000>;
};

&wifi_led {
	label = "vocore2:fuchsia:wifi";
};
